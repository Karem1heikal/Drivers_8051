
ORG 00H

LJMP MAIN
	ORG 0003H
	MOV	R0 ,#1
	RETI
	MAIN:
	;=======================================================================
	LCD_PORT EQU P1
	RS BIT P2.0
	E BIT P2.1
	MOV LCD_PORT , #00H
	CLR RS
	CLR E
	
	RIGHT BIT P2.4
	LEFT BIT P2.5
	UP BIT P2.6
	DOWN BIT P2.7
	RESET BIT P3.2
	START BIT P3.3
	SETB RIGHT
	SETB LEFT
	SETB UP
	SETB DOWN 
	SETB RESET
	SETB START
	
	MOV IE ,#81H
	SETB TCON.0
	LCALL LCD_INIT
	
	MOV R0,#0 ; flag for chick interrupt flag
	MOV R1,#0
	MOV R2,#0
	MOV R3,#0
	
	ACALL PRINT_CLK
	
	MOV A,#80H
	ACALL LCD_COMM
	MOV A,#14H
	ACALL LCD_COMM
	MOV R4,#1
	SJMP HERE
	
	
	PLAY:
	SEC_LOOP:
	CJNE R0 ,#1,NO_INTERRUPT
	MOV R0,#0
	SJMP HERE
	NO_INTERRUPT:
	CJNE R1,#59 ,NOT_SEC
	MOV R1 ,#0
	SJMP MIN_LOOP
	NOT_SEC:
	ACALL LCD_CLEAR
	ACALL PRINT_CLK
	INC R1
	ACALL DELAY_1mS
	SJMP SEC_LOOP
	MIN_LOOP:
	CJNE R2,#59 ,NOT_MIN
	MOV R1 ,#0
	MOV R2 ,#0
	SJMP HOUR_LOOP
	NOT_MIN:
	INC R2
	SJMP SEC_LOOP
	HOUR_LOOP:
	CJNE R3,#23 ,NOT_HOUR
	MOV R1 ,#0
	MOV R2 ,#0
	MOV R3 ,#0
	SJMP SEC_LOOP
	NOT_HOUR:
	INC R3
	MOV R3 ,#0
	SJMP SEC_LOOP
	
	MOVE_RIGHT:
	ACALL DELAY_DEBOUNCE
	JB RIGHT ,HERE
	CJNE R4,#3,APP_NOT_EQ1
	SJMP G1
	APP_NOT_EQ1:JNC G1
	INC R4
	SJMP AGIAN1
	G1: MOV R4,#3
	AGIAN1:LCALL RETURN_POSITION
	SJMP HERE
	
	MOVE_LEFT:
	ACALL DELAY_DEBOUNCE
	JB LEFT ,HERE
	CJNE R4,#1,APP_NOT_EQ2
	SJMP S1
	APP_NOT_EQ2:JC S1
	DEC R4 
	SJMP AGIAN2
	S1: MOV R4,#1
	AGIAN2:LCALL RETURN_POSITION
	SJMP HERE
	; =========================== UP SWITCH =======================
	HERE:
	JNB RIGHT ,MOVE_RIGHT
	JNB LEFT ,MOVE_LEFT
	
	JNB UP ,MOVE_UP
	JNB DOWN ,MOVE_DOWN
	
	JNB START ,PLAY
	SJMP HERE
	
	
	MOVE_UP:
	
	CJNE R4,#1,MINT
	INC R3
	MOV A,R3
	XRL A,#24
	JZ CONT_H
	ACALL LCD_CLEAR
	MOV A,R3
	ACALL PRINT_CLK
	LCALL RETURN_POSITION
	SJMP HERE
	CONT_H:
	MOV R3,A
	ACALL LCD_CLEAR
	MOV A,R3
	ACALL PRINT_CLK
	LCALL RETURN_POSITION
	SJMP HERE
	
	
	MINT:
	CJNE R4,#2,SECT
	INC R2
	MOV A,R2
	XRL A,#60
	JZ CONT_M
	ACALL LCD_CLEAR
	MOV A,R2
	ACALL PRINT_CLK
	LJMP HERE
	CONT_M:
	MOV R2,A
	ACALL LCD_CLEAR
	MOV A,R2
	ACALL PRINT_CLK
	LJMP HERE
	SECT:
	INC R1
	MOV A,R1
	XRL A,#60
	JZ CONT_S
	ACALL LCD_CLEAR
	MOV A,R1
	ACALL PRINT_CLK
	LJMP HERE
	CONT_S:
	MOV R1,A
	ACALL LCD_CLEAR
	MOV A,R1
	ACALL PRINT_CLK
	LJMP HERE
	; =========================== DOWN SWITCH =======================
	MOVE_DOWN:
	CJNE R4,#1,MINT1
	MOV A,R3
	XRL A,#0
	JZ CONT_HOUR0
	DEC R3
	ACALL LCD_CLEAR
	MOV A,R3
	ACALL PRINT_CLK
	LJMP HERE
	CONT_HOUR0:
	MOV A,#23
	MOV R3,A
	ACALL LCD_CLEAR
	MOV A,R3
	ACALL PRINT_CLK
	LJMP HERE
	
	MINT1:
	CJNE R4,#2,SECT1
	MOV A,R2
	XRL A,#0
	JZ CONT_MIN0
	DEC R2
	ACALL LCD_CLEAR
	MOV A,R2
	ACALL PRINT_CLK
	LJMP HERE
	CONT_MIN0:
	MOV A,#59
	MOV R2,A
	ACALL LCD_CLEAR
	MOV A,R2
	ACALL PRINT_CLK
	LJMP HERE
	
	SECT1:
	MOV A,R1
	XRL A,#0
	JZ CONT_SEC0
	DEC R1
	ACALL LCD_CLEAR
	MOV A,R1
	ACALL PRINT_CLK
	LJMP HERE
	
	CONT_SEC0:
	MOV A,#59
	MOV R1,A
	ACALL LCD_CLEAR
	MOV A,R1
	ACALL PRINT_CLK
	LJMP HERE
	
	;================================================== PROG FUNCTION =====================================
	
	DELAY_DEBOUNCE: MOV R5 , #255
	LD1: MOV R6 , #255
	LD2: DJNZ R6 , LD2
	DJNZ R5 , LD1
	RET
	
	DELAY_1mS:
	MOV R5 , #7
	L1:MOV R6 , #250
	L2: MOV R7 , #250
	L3: DJNZ R7 , L3
		DJNZ R6 , L2
		DJNZ R5 , L1
	RET
	RETURN_POSITION:
	PUSH ACC
	MOV A,#80H
	ACALL LCD_COMM
	CJNE R4,#1,POS_NOT1
	MOV A,#014H
	ACALL LCD_COMM
	SJMP POS_NOT3
	POS_NOT1:
	CJNE R4,#2,POS_NOT2
	MOV A,#014H
	ACALL LCD_COMM
	MOV A,#014H
	ACALL LCD_COMM
	MOV A,#014H
	ACALL LCD_COMM
	MOV A,#014H
	ACALL LCD_COMM
	SJMP POS_NOT3
	POS_NOT2:
	CJNE R4,#3,POS_NOT3
	MOV A,#014H
	ACALL LCD_COMM
	MOV A,#014H
	ACALL LCD_COMM
	MOV A,#014H
	ACALL LCD_COMM
	MOV A,#014H
	ACALL LCD_COMM
	MOV A,#014H
	ACALL LCD_COMM
	MOV A,#014H
	ACALL LCD_COMM
	MOV A,#014H
	ACALL LCD_COMM
	POS_NOT3:
	POP ACC
	RET
	
	PRINT_CLK:
	MOV A,R3
	MOV B,#10
	DIV AB
	ACALL LCD_NUM
	MOV A,B
	ACALL LCD_NUM
	MOV A,#':'
	ACALL LCD_DATA
	MOV A,R2
	MOV B,#10
	DIV AB
	ACALL LCD_NUM
	MOV A,B
	ACALL LCD_NUM
	MOV A,#':'
	ACALL LCD_DATA
	MOV A,R1
	MOV B,#10
	DIV AB
	ACALL LCD_NUM
	MOV A,B
	ACALL LCD_NUM
	
	RET 
	
		;=============================================================LCD_DISPLAY_RESULT=======================================================================;	
LCD_INIT:
	MOV A , #01H
	ACALL LCD_COMM
	MOV A , #38H
	ACALL LCD_COMM
	MOV A , #0EH
	ACALL LCD_COMM
	RET

LCD_NUM: 
       
	    CJNE A ,#10, NOT_EQ1
		SJMP RESULT_2_DIGITS
NOT_EQ1:
        JNC NEXT1
		
RESULT_1_DIGITS:	
        ORL A ,#30H
		ACALL LCD_DATA
		SJMP EXT
NEXT1:  
        CJNE A ,#100, NOT_EQ2
	    SJMP RESULT_3_DIGITS
NOT_EQ2:
	    JNC NEXT2
RESULT_2_DIGITS:		
	    MOV B ,#10
	    DIV AB
		ORL A ,#30H
		ACALL LCD_DATA
		MOV A ,B
		ORL A ,#30H
		ACALL LCD_DATA
	    SJMP EXT
		
	
NEXT2:
       CJNE A ,#255, NOT_EQ3
        SJMP RESULT_3_DIGITS
NOT_EQ3:
	   JNC EXT
RESULT_3_DIGITS:
       MOV B ,#100
	   DIV AB
	   ORL A ,#30H
	   ACALL LCD_DATA
	   MOV A ,B
	   MOV B ,#10
	   DIV AB
	   ORL A ,#30H
	   ACALL LCD_DATA
	   MOV A ,B
	   ORL A ,#30H
	   ACALL LCD_DATA
	   
EXT:   RET
	
LCD_COMM:
	   MOV LCD_PORT , A
	   CLR RS
	   SETB E
	   NOP
	   NOP
	   NOP
	   CLR E
	   ACALL DELAY
	   RET
	
LCD_DATA:
	MOV LCD_PORT , A
	SETB RS
	SETB E
	NOP
	NOP
	NOP
	CLR E
	ACALL DELAY
	RET
	
LCD_CLEAR:
	MOV A , #01H
	ACALL LCD_COMM
	RET
	
	DELAY:
	MOV R5 , #50H
	LL1: MOV R6 , #0FFH
	LL2: DJNZ R6 , LL2
	DJNZ R5 , LL1
	RET
	
END